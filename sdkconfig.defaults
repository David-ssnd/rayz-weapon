## sdkconfig.defaults
```kconfig
# Bluetooth configuration
# CONFIG_BT_ENABLED=y
# CONFIG_BT_NIMBLE_ENABLED=y
# CONFIG_BT_NIMBLE_ROLE_PERIPHERAL=y
# CONFIG_BT_NIMBLE_ROLE_BROADCASTER=y
# CONFIG_BT_NIMBLE_MAX_CONNECTIONS=1

# FreeRTOS configuration
CONFIG_FREERTOS_HZ=1000
CONFIG_FREERTOS_USE_TRACE_FACILITY=y
CONFIG_FREERTOS_USE_STATS_FORMATTING_FUNCTIONS=y

# HTTP Server with WebSocket support
CONFIG_HTTPD_WS_SUPPORT=y

# Compiler options
CONFIG_COMPILER_CXX_EXCEPTIONS=y
CONFIG_COMPILER_CXX_RTTI=y

# ESP32-C3 specific
CONFIG_ESP32C3_DEFAULT_CPU_FREQ_160=y

# Log level
CONFIG_LOG_DEFAULT_LEVEL_INFO=y
CONFIG_LOG_MAXIMUM_LEVEL_VERBOSE=y

# USB CDC
CONFIG_ESP_CONSOLE_USB_CDC=y
CONFIG_ESP_CONSOLE_SECONDARY_USB_SERIAL_JTAG=y
```
